## HOWTO_examples/createProject/sel4project/apps/app1/Kconfig
```kconfig
menuconfig APP_APP1
    bool "Application 1"
    default y
    depends on LIB_SEL4 && (LIB_MUSL_C || LIB_SEL4_C) && LIB_SEL4_PLAT_SUPPORT && LIB_SEL4_UTILS
    help
       Hello world
```

## HOWTO_examples/runTwoDomains/sel4project/apps/app1/Kconfig
```kconfig
menuconfig APP_APP1
    bool "Application 1"
    default y
    depends on LIB_SEL4 && (LIB_MUSL_C || LIB_SEL4_C) && LIB_SEL4_SIMPLE && LIB_SEL4_VKA && LIB_SEL4_ALLOCMAN && LIB_SEL4_VSPACE && LIB_SEL4_PLAT_SUPPORT && LIB_SEL4_UTILS && LIB_CPIO && LIB_ELF && LIB_UTILS
    help
       Hello world
```

## HOWTO_examples/runTwoDomains/sel4project/apps/app2/Kconfig
```kconfig
menuconfig APP_APP2
    bool "Application 2"
    default y
    depends on LIB_SEL4 && (LIB_MUSL_C || LIB_SEL4_C) && LIB_SEL4_PLAT_SUPPORT && LIB_SEL4_UTILS
    help
       Hello world app 2
```

## empty_app/Kconfig
```kconfig
menuconfig APP_<APP_NAME>
    bool "<Some name>"
    default y
    depends on LIB_SEL4 && (LIB_MUSL_C || LIB_SEL4_C) && LIB_SEL4_PLAT_SUPPORT && LIB_UTILS
    help
       <Some description>
```
